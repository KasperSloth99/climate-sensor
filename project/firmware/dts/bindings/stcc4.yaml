## project/firmware/dts/bindings/stcc4.yaml
```yaml
description: Sensirion STCC4 Co2 Sensor

compatible: "sensirion,stcc4"

include: [sensor-device.yaml, i2c-device.yaml]
```

## project/firmware/lib/Kconfig
```kconfig
config WIFI_CONNECTOR
    bool "Enable my wifi library"
    select NETWORKING
    select NET_LOG
    select NET_SHELL
    select NET_STATISTICS
    select WIFI_ESP32
    select ESP32_WIFI_STA_MODE
    select WIFI
    select NET_L2_WIFI_SHELL
    select NET_IPV4
    select NET_TCP
    select NET_CONFIG_SETTINGS
    select NET_IP
    select NET_INTERFACE_NAME
    select NET_DHCPV4
```

## project/firmware/lib/wifi/connection/Kconfig
```kconfig
config MY_WIFI_CONNECTION
    bool "My wifi connection"
    select NETWORKING
    select WIFI
    select WIFI_ESP32
    select NET_IPV4
    select NET_DHCPV4
    select NET_SOCKETS
    select EVENTS

config MY_WIFI_CONNECTION_SHELL
    bool "Add shell option for key storage"
    depends on MY_WIFI_CONNECTION
    select SHELL
    select NET_SHELL
```

## project/firmware/lib/wifi/keys/Kconfig
```kconfig
config MY_WIFI_KEYS
    bool "Config my wifi storage for SSID / Passphrases"
    select FLASH
    select FLASH_MAP
    select FILE_SYSTEM
    select FSTAB
    select FILE_SYSTEM_LITTLEFS
    select FILE_SYSTEM_LIB_LINK
    select JSON_LIBRARY

config MY_WIFI_KEYS_SHELL
    bool "Add shell option for key storage"
    select SHELL
    select FILE_SYSTEM_SHELL
```

## project/firmware/west.yml
```yaml
manifest:
  version: "0.12"

  projects:
    - name: zephyr
      revision: v4.2.0
      url: https://github.com/zephyrproject-rtos/zephyr
      west-commands: scripts/west-commands.yml
      import:
        name-allowlist:
          - cmsis_6
          - hal_espressif

    - name: esp-idf
      url: https://github.com/espressif/esp-idf
      path: modules/hal/espressif/esp-idf
      revision: v5.1.2  # Change this to match the Zephyr-supported version

  self:
    path: app  # Your application path
```
